## CMakeLists.txt
```
# SPDX-FileCopyrightText: Copyright The Zephyr Project Contributors
# SPDX-License-Identifier: Apache-2.0

cmake_minimum_required(VERSION 3.20.0)
find_package(Zephyr REQUIRED HINTS $ENV{ZEPHYR_BASE})
project(mec_assy6941_pm)

target_sources(app PRIVATE
  src/main.c
  src/power_mgmt.c
  src/counter_alarm.c
)
```

## prj.conf
```kconfig
# System power management only: devices stay enabled across a low-power state
# and the MEC SoC layer masks the peripherals that ignore SLP_EN. See
# pm-device.conf for the CONFIG_PM_DEVICE variant.
CONFIG_PM=y

CONFIG_LOG=y
CONFIG_THREAD_NAME=y

# The logging thread must run less often than the shortest sleep under test, or
# it wakes the system before the residency is met.
CONFIG_LOG_PROCESS_THREAD_SLEEP_MS=2100

CONFIG_IDLE_STACK_SIZE=512
```

## pm-device.conf
```kconfig
# System power management with device power management: the PM core suspends
# drivers before entering a low-power state and resumes them after, so each
# driver's pm_action handles its own hardware.
#
# The console UART is suspended across the sleep, so output pauses there and
# resumes on wake.
CONFIG_PM=y
CONFIG_PM_DEVICE=y
CONFIG_PM_DEVICE_SYSTEM_MANAGED=y

CONFIG_LOG=y
CONFIG_THREAD_NAME=y
CONFIG_LOG_PROCESS_THREAD_SLEEP_MS=2100
CONFIG_IDLE_STACK_SIZE=512
```

## cct_ktimer.overlay
```dts
/*
 * Copyright (c) Microchip Technology Inc.
 * SPDX-License-Identifier: Apache-2.0
 *
 * Use the capture-compare timer driver as the Zephyr kernel timer in
 * place of the RTOS timer.
 */

/* The RTOS timer stays disabled so its kernel timer driver is not built.
 * The capture-compare timer driver makes use of the RTOS timer HW directly
 * as its low power companion when PM is enabled in the build.
 */
&rtimer {
	status = "disabled";
};

&systick {
	status = "disabled";
};

&cctmr0 {
	status = "okay";
};
```

## counter_alarm.overlay
```dts
/*
 * Copyright (c) Microchip Technology Inc.
 * SPDX-License-Identifier: Apache-2.0
 *
 * Enable a 32-bit basic timer as a counter device and name it for the
 * sample's counter alarm phase. timer5 is deliberately not used: the XEC
 * RTOS kernel timer borrows it for arch_busy_wait().
 */

/ {
	chosen {
		zephyr,counter = &timer4;
	};
};

&timer4 {
	status = "okay";
};
```

## boards/mec_assy6941_mec1753_qlj.overlay
```dts
/*
 * Copyright (c) Microchip Technology Inc.
 * SPDX-License-Identifier: Apache-2.0
 */

#include <zephyr/dt-bindings/gpio/microchip-xec-gpio.h>

&pcr {
	pinctrl-0 = <&tst_clk_out_gpio060>;
	pinctrl-names = "default";
};

/* GPIO004 is pulled up on the EVB and is used purely as a scope trigger: the
 * sample drives it low across the counter alarm phase so that phase's PLL
 * behaviour can be captured on its own, separately from the repeating pattern
 * of the earlier phases.
 */
/ {
	zephyr,user {
		gpios = <MCHP_GPIO_DECODE_004 GPIO_ACTIVE_HIGH>;
	};
};
```

## src/main.c
```c
/*
 * SPDX-FileCopyrightText: Copyright The Zephyr Project Contributors
 * SPDX-License-Identifier: Apache-2.0
 */

#include <zephyr/kernel.h>
#include <zephyr/device.h>
#include <zephyr/drivers/gpio.h>
#include <zephyr/pm/device.h>
#include <zephyr/logging/log.h>

#include "power_mgmt.h"

LOG_MODULE_REGISTER(mec_assy6941_pm, LOG_LEVEL_INF);

#define MAX_CYCLES 5U

BUILD_ASSERT(IS_ENABLED(CONFIG_PM), "this sample requires CONFIG_PM");

#define ZEPHYR_USER_NODE DT_PATH(zephyr_user)

/* GPIO004 on the EVB, pulled up, used purely as a scope trigger: it is driven
 * low across the counter alarm phase so the PLL behaviour during that phase can
 * be captured on its own. See the README.
 */
static const struct gpio_dt_spec marker_gpio = GPIO_DT_SPEC_GET(ZEPHYR_USER_NODE, gpios);

/*
 * CONFIG_PM alone leaves every device enabled across a low-power state, so the
 * peripherals that ignore the chip's SLP_EN signals keep their clock request
 * asserted and the PCR will not gate the PLL. The MEC SoC layer works around
 * that for the Basic Timers and the UARTs in its deep-sleep path, which is why
 * deep sleep works without CONFIG_PM_DEVICE.
 *
 * With CONFIG_PM_DEVICE and CONFIG_PM_DEVICE_SYSTEM_MANAGED the PM subsystem
 * suspends devices before entering the state and resumes them after, so a
 * driver's own pm_action handles its hardware instead. The two paths reach
 * deep sleep differently and both need testing, so report which one is built
 * rather than silently testing only one.
 *
 * Note the UART is the console here: with system-managed device PM it is
 * suspended across the sleep, so output stops at the suspend and resumes
 * afterwards. That is expected, not a hang.
 */
static void report_build_config(void)
{
	LOG_INF("MEC ASSY6941 power management sample");

	if (IS_ENABLED(CONFIG_PM_DEVICE)) {
		if (IS_ENABLED(CONFIG_PM_DEVICE_SYSTEM_MANAGED)) {
			LOG_INF("Device PM: system managed (drivers suspended by the PM core)");
		} else if (IS_ENABLED(CONFIG_PM_DEVICE_RUNTIME)) {
			LOG_INF("Device PM: runtime only (drivers not suspended by the PM core)");
		} else {
			LOG_INF("Device PM: enabled, neither system managed nor runtime");
		}
	} else {
		LOG_INF("Device PM: disabled (SoC masks non-compliant peripherals)");
	}

	LOG_INF("Kernel timer: %u Hz cycle counter, %u Hz tick",
		(unsigned int)sys_clock_hw_cycles_per_sec(),
		(unsigned int)CONFIG_SYS_CLOCK_TICKS_PER_SEC);
}

#if defined(CONFIG_PM_DEVICE) && defined(CONFIG_PM_DEVICE_SYSTEM_MANAGED)
/*
 * With system-managed device PM the console UART is suspended while the system
 * sleeps. Give its driver a chance to drain the FIFO before the suspend, so the
 * preceding log lines are not lost mid-transmission.
 */
static void flush_console(void)
{
	k_msleep(50);
}
#else
static void flush_console(void)
{
}
#endif

int main(void)
{
	int ret;
	int result = 0;

	report_build_config();

	ret = gpio_pin_configure_dt(&marker_gpio, GPIO_OUTPUT_HIGH);
	if (ret != 0) {
		LOG_ERR("Could not configure the GPIO004 scope marker (%d)", ret);
	}

	flush_console();

	ret = test_pwr_mgmt_singlethread(false, MAX_CYCLES);
	if (ret != 0) {
		LOG_ERR("Single-thread test failed: %d", ret);
		result = ret;
	}
	flush_console();

	ret = test_pwr_mgmt_singlethread(true, MAX_CYCLES);
	if (ret != 0) {
		LOG_ERR("Single-thread test (logging) failed: %d", ret);
		result = ret;
	}
	flush_console();

	ret = test_pwr_mgmt_multithread(false, MAX_CYCLES);
	if (ret != 0) {
		LOG_ERR("Multi-thread test failed: %d", ret);
		result = ret;
	}
	flush_console();

	ret = test_pwr_mgmt_multithread(true, MAX_CYCLES);
	if (ret != 0) {
		LOG_ERR("Multi-thread test (logging) failed: %d", ret);
		result = ret;
	}
	flush_console();

	/* Scope trigger: the pin idles high and is driven low across the phase. */
	gpio_pin_set_raw(marker_gpio.port, marker_gpio.pin, 0);
	ret = test_pwr_mgmt_counter_alarm();
	gpio_pin_set_raw(marker_gpio.port, marker_gpio.pin, 1);

	if (ret != 0) {
		LOG_ERR("Counter alarm test failed: %d", ret);
		result = ret;
	}
	flush_console();

	ret = test_pwr_mgmt_check_uptime();
	if (ret != 0) {
		result = ret;
	}

	if (result != 0) {
		LOG_ERR("PM sample failed: %d", result);
		printk("PM sample FAILED\n");
		return result;
	}

	LOG_INF("PM sample completed");
	printk("PM sample PASSED\n");

	return 0;
}
```

## src/counter_alarm.c
```c
/*
 * SPDX-FileCopyrightText: Copyright The Zephyr Project Contributors
 * SPDX-License-Identifier: Apache-2.0
 */

/*
 * Deep sleep with a counter alarm armed.
 *
 * A Basic Timer ignores the chip's SLP_EN signal, so one left running keeps
 * its CLK_REQ asserted and the PCR will not gate the PLL. The XEC counter
 * driver's pm_action therefore stops a counter on suspend, except when an
 * alarm or a periodic top callback is armed: stopping it would drop the event
 * the application asked for, so the block is left running and the PLL stays
 * on for the duration of the sleep.
 *
 * This exercises that branch, which nothing else in the sample reaches. Two
 * things are worth watching on a scope while it runs:
 *
 *   - TEST_CLK_OUT (GPIO060) should stay active through the sleep, where the
 *     other phases show it gated. That is the PLL being held up, which is the
 *     expected cost rather than a fault.
 *   - With CONFIG_SOC_MEC_PM_DBG_PCR_CLK_REQ_VBM the saved CLK_REQ registers
 *     should show this timer's bit set on entry.
 */

#include <zephyr/kernel.h>
#include <zephyr/device.h>
#include <zephyr/drivers/counter.h>
#include <zephyr/logging/log.h>

#include "power_mgmt.h"

LOG_MODULE_DECLARE(mec_assy6941_pm, LOG_LEVEL_INF);

#if DT_HAS_CHOSEN(zephyr_counter)

#define ALARM_COUNTER_NODE DT_CHOSEN(zephyr_counter)

/* Long enough that the alarm cannot plausibly fire before the sleep is
 * entered, short enough to stay inside a 32-bit tick count at 48 MHz
 * (89 s there) and to keep the sample's runtime reasonable.
 */
#define ALARM_DELAY_MS 4000U

/* Slept past the deep-sleep residency, and past the alarm, so the alarm is
 * what ends the sleep rather than the sleep ending first.
 */
#define ALARM_SLEEP_MS 6000U

static const struct device *const counter_dev = DEVICE_DT_GET(ALARM_COUNTER_NODE);

static struct k_sem alarm_fired;

/*
 * The ticks argument is not recorded. This driver's ISR passes counter->CNT,
 * and by then the one-shot has expired and the block has reloaded from PRLD,
 * so the value read is the preload rather than the count at the alarm: on a
 * 32-bit timer it is always UINT32_MAX. The uptime delta around the sleep is
 * the meaningful measure, and the semaphore is what says the alarm arrived.
 */
static void alarm_handler(const struct device *dev, uint8_t chan_id, uint32_t ticks,
			  void *user_data)
{
	ARG_UNUSED(dev);
	ARG_UNUSED(chan_id);
	ARG_UNUSED(ticks);
	ARG_UNUSED(user_data);

	k_sem_give(&alarm_fired);
}

int test_pwr_mgmt_counter_alarm(void)
{
	struct counter_alarm_cfg cfg = {
		.callback = alarm_handler,
		.user_data = NULL,
		.flags = 0,
	};
	int64_t before;
	int64_t elapsed;
	int ret;

	if (!device_is_ready(counter_dev)) {
		LOG_ERR("Counter %s not ready", counter_dev->name);
		return -ENODEV;
	}

	LOG_WRN("Deep sleep with a counter alarm armed on %s", counter_dev->name);

	k_sem_init(&alarm_fired, 0, 1);

	ret = counter_start(counter_dev);
	if ((ret != 0) && (ret != -EALREADY)) {
		LOG_ERR("counter_start: %d", ret);
		return ret;
	}

	cfg.ticks = counter_us_to_ticks(counter_dev, (uint64_t)ALARM_DELAY_MS * USEC_PER_MSEC);

	ret = counter_set_channel_alarm(counter_dev, 0, &cfg);
	if (ret != 0) {
		LOG_ERR("counter_set_channel_alarm: %d", ret);
		(void)counter_stop(counter_dev);
		return ret;
	}

	LOG_INF("Alarm armed for %u ms (%u ticks); PLL is expected to stay on",
		ALARM_DELAY_MS, cfg.ticks);

	/* Sleep past the deep-sleep residency so the PM policy picks that
	 * state with the counter still running.
	 */
	before = k_uptime_get();
	k_msleep(ALARM_SLEEP_MS);
	elapsed = k_uptime_get() - before;

	if (k_sem_take(&alarm_fired, K_NO_WAIT) != 0) {
		LOG_ERR("Alarm did not fire across the sleep");
		(void)counter_cancel_channel_alarm(counter_dev, 0);
		(void)counter_stop(counter_dev);
		return -EIO;
	}

	LOG_INF("Alarm fired across deep sleep; uptime advanced %lld ms of %u ms requested",
		(long long)elapsed, ALARM_SLEEP_MS);

	/* The driver's pm_action left the block alone, so the counter is still
	 * running here. Stop it so the following phases can gate the PLL.
	 */
	ret = counter_stop(counter_dev);
	if (ret != 0) {
		LOG_ERR("counter_stop: %d", ret);
		return ret;
	}

	return 0;
}

#else /* !DT_HAS_CHOSEN(zephyr_counter) */

int test_pwr_mgmt_counter_alarm(void)
{
	LOG_INF("No chosen zephyr,counter; skipping the counter alarm phase");

	return 0;
}

#endif /* DT_HAS_CHOSEN(zephyr_counter) */
```

## src/power_mgmt.c
```c
/*
 * SPDX-FileCopyrightText: Copyright The Zephyr Project Contributors
 * SPDX-License-Identifier: Apache-2.0
 */

#include <errno.h>
#include <zephyr/kernel.h>
#include <zephyr/device.h>
#include <zephyr/pm/pm.h>
#include <zephyr/pm/device.h>
#include <zephyr/drivers/gpio.h>
#include <zephyr/logging/log.h>

#include "power_mgmt.h"

LOG_MODULE_DECLARE(mec_assy6941_pm, LOG_LEVEL_INF);

/* suspend-to-idle and suspend-to-ram */
#define SLP_STATES_SUPPORTED 2U

#define TASK_STACK_SIZE 1024U
#define PRIORITY        K_PRIO_COOP(5)

/* Thread periods, both below the suspend-to-idle residency so the threads keep
 * the system out of a low-power state while they run.
 */
#define THREAD_A_SLEEP_TIME 100U
#define THREAD_B_SLEEP_TIME 1000U

/*
 * Entry latency budget, in milliseconds.
 *
 * Latency here is measured from the application's trigger marker to the PM
 * core entering the state, so it includes however long the system stays busy
 * first. The logging thread runs every CONFIG_LOG_PROCESS_THREAD_SLEEP_MS and
 * each of its wakeups defers entry, so the budget has to clear that period or
 * it flags ordinary behaviour. One period plus a margin for the work itself.
 */
#define MAX_EXPECTED_MS_LATENCY (CONFIG_LOG_PROCESS_THREAD_SLEEP_MS + 500)

/* Slept past each state's minimum residency so the policy selects it. */
#define DP_EXTRA_SLP_TIME 1100U
#define LT_EXTRA_SLP_TIME 500U

/*
 * Uptime tolerance per sleep, in milliseconds.
 *
 * Across a low-power state the kernel timer recovers elapsed time from the
 * always-on 32 KHz companion, whose resolution is 30.5 us, and a deep sleep
 * adds up to 3 ms of PLL relock. k_msleep() also rounds up to a tick. 20 ms
 * covers all of that with room to spare while still catching a companion that
 * mismeasures an interval, which is the failure this is here to find.
 */
#define MAX_UPTIME_ERROR_MS 20

#define SEC_TO_MSEC 1000U

K_THREAD_STACK_DEFINE(stack_a, TASK_STACK_SIZE);
K_THREAD_STACK_DEFINE(stack_b, TASK_STACK_SIZE);

static struct k_thread thread_a_id;
static struct k_thread thread_b_id;

/*
 * Pause handshake for the worker threads.
 *
 * k_thread_suspend() does not cancel a pending timeout: halt_thread() aborts
 * one only for _THREAD_DEAD (kernel/sched.c). A thread suspended part-way
 * through k_msleep() keeps that timeout live, so the kernel wakes to service
 * it and the sleep under test ends early or is never entered at the depth
 * requested. That is what limited this sample to 3 of 5 light and 2 of 5 deep
 * sleeps.
 *
 * Instead each worker parks itself on a semaphore with K_FOREVER, which
 * registers no timeout at all (z_add_timeout() returns immediately for
 * K_FOREVER), and the caller waits on a second semaphore until both have
 * parked. k_wakeup() cuts short a worker that is mid-k_msleep(), and unlike
 * suspend it does abort the timeout.
 */
static bool run_threads;
static struct k_sem parked_sem;
static struct k_sem resume_sem;

struct pm_counter {
	uint8_t entry_cnt;
	uint8_t exit_cnt;
};

static int64_t trigger_time;
static bool checks_enabled;
static struct pm_counter pm_counters[SLP_STATES_SUPPORTED];

/* Worst uptime error seen over all sleeps, in milliseconds. */
static int64_t worst_uptime_error_ms;

static const struct pm_state_info residency_info[] =
	PM_STATE_INFO_LIST_FROM_DT_CPU(DT_NODELABEL(cpu0));
static const size_t residency_info_len = DT_NUM_CPU_POWER_STATES(DT_NODELABEL(cpu0));

BUILD_ASSERT(ARRAY_SIZE(residency_info) >= 2,
	     "the board must define a light and a deep power state");

/*
 * Optional entry/exit markers.
 *
 * The MEC15xx version of this sample wrote GPIO control registers directly,
 * which does not build on MEC5. Here the pins are devicetree-supplied and
 * entirely optional: define pm-markers in an overlay to drive them, otherwise
 * the sample runs without.
 */
#define PM_MARKERS_NODE DT_PATH(zephyr_user)

#if DT_NODE_HAS_PROP(PM_MARKERS_NODE, pm_gpios)
#define PM_MARKER_COUNT DT_PROP_LEN(PM_MARKERS_NODE, pm_gpios)
static const struct gpio_dt_spec pm_markers[] = {
	DT_FOREACH_PROP_ELEM_SEP(PM_MARKERS_NODE, pm_gpios, GPIO_DT_SPEC_GET_BY_IDX, (,))};
#else
#define PM_MARKER_COUNT 0
static const struct gpio_dt_spec pm_markers[] = {};
#endif

/* Marker indices: light sleep, deep sleep, application trigger. */
#define PM_MARKER_LIGHT   0
#define PM_MARKER_DEEP    1
#define PM_MARKER_TRIGGER 2

static void pm_marker_init(void)
{
	for (size_t i = 0; i < PM_MARKER_COUNT; i++) {
		int ret = gpio_pin_configure_dt(&pm_markers[i], GPIO_OUTPUT_INACTIVE);

		if (ret != 0) {
			LOG_WRN("Marker %u unavailable: %d", (unsigned int)i, ret);
		}
	}
}

/* Markers are diagnostics, so a failed write is not worth failing the test
 * over and the return value is deliberately discarded.
 */
static void pm_marker_set(uint8_t idx, bool active)
{
	if (idx < PM_MARKER_COUNT) {
		(void)gpio_pin_set_dt(&pm_markers[idx], active ? 1 : 0);
	}
}

static void pm_latency_check(void)
{
	int64_t latency = k_uptime_delta(&trigger_time);

	LOG_INF("PM sleep entry latency %d.%03d seconds", (int)(latency / SEC_TO_MSEC),
		(int)(latency % SEC_TO_MSEC));

	if (latency > (int64_t)MAX_EXPECTED_MS_LATENCY) {
		LOG_WRN("Sleep entry latency is higher than expected (budget %d ms)",
			(int)MAX_EXPECTED_MS_LATENCY);
	}
}

static void notify_pm_state_entry(enum pm_state state)
{
	if (!checks_enabled) {
		return;
	}

	switch (state) {
	case PM_STATE_SUSPEND_TO_IDLE:
		pm_marker_set(PM_MARKER_LIGHT, true);
		pm_counters[0].entry_cnt++;
		break;
	case PM_STATE_SUSPEND_TO_RAM:
		pm_marker_set(PM_MARKER_DEEP, true);
		pm_counters[1].entry_cnt++;
		pm_latency_check();
		break;
	default:
		break;
	}
}

static void notify_pm_state_exit(enum pm_state state)
{
	if (!checks_enabled) {
		return;
	}

	switch (state) {
	case PM_STATE_SUSPEND_TO_IDLE:
		pm_marker_set(PM_MARKER_LIGHT, false);
		pm_counters[0].exit_cnt++;
		break;
	case PM_STATE_SUSPEND_TO_RAM:
		pm_marker_set(PM_MARKER_DEEP, false);
		pm_counters[1].exit_cnt++;
		break;
	default:
		break;
	}
}

static int pm_check_counters(uint8_t cycles)
{
	int ret = 0;

	for (int i = 0; i < SLP_STATES_SUPPORTED; i++) {
		LOG_INF("PM state[%d] entry counter %d", i, pm_counters[i].entry_cnt);
		LOG_INF("PM state[%d] exit counter %d", i, pm_counters[i].exit_cnt);

		if (pm_counters[i].entry_cnt != pm_counters[i].exit_cnt) {
			LOG_ERR("PM state[%d] entry/exit mismatch", i);
			ret = -EIO;
		}

		if (pm_counters[i].entry_cnt != cycles) {
			LOG_ERR("PM state[%d] counter %d, expected %d", i,
				pm_counters[i].entry_cnt, cycles);
			ret = -EIO;
		}

		pm_counters[i].entry_cnt = 0;
		pm_counters[i].exit_cnt = 0;
	}

	return ret;
}

static void pm_reset_counters(void)
{
	for (int i = 0; i < SLP_STATES_SUPPORTED; i++) {
		pm_counters[i].entry_cnt = 0;
		pm_counters[i].exit_cnt = 0;
	}

	checks_enabled = false;
	pm_marker_set(PM_MARKER_TRIGGER, false);
}

static void pm_trigger_marker(void)
{
	trigger_time = k_uptime_get();
	pm_marker_set(PM_MARKER_TRIGGER, true);
	printk("PM >\n");
}

static void pm_exit_marker(void)
{
	pm_marker_set(PM_MARKER_TRIGGER, false);
	printk("PM <\n");

	if (trigger_time > 0) {
		int64_t residency_delta = k_uptime_delta(&trigger_time);

		LOG_INF("PM sleep residency %d.%03d seconds",
			(int)(residency_delta / SEC_TO_MSEC),
			(int)(residency_delta % SEC_TO_MSEC));
	}
}

/*
 * Sleep for @p sleep_ms and record how far uptime advanced against it.
 *
 * The kernel timer cannot measure a low-power state itself; it recovers the
 * interval from the always-on companion. An error here means that recovery is
 * wrong, which is invisible to the entry/exit counters.
 */
static void pm_sleep_and_measure(uint32_t sleep_ms, const char *what)
{
	int64_t before = k_uptime_get();
	int64_t slept;
	int64_t error;

	k_msleep(sleep_ms);

	slept = k_uptime_get() - before;
	error = slept - (int64_t)sleep_ms;
	if (error < 0) {
		error = -error;
	}

	if (error > worst_uptime_error_ms) {
		worst_uptime_error_ms = error;
	}

	if (error > MAX_UPTIME_ERROR_MS) {
		LOG_ERR("%s: slept %lld ms, uptime advanced %lld ms (error %lld ms)", what,
			(long long)sleep_ms, (long long)slept, (long long)error);
	} else {
		LOG_DBG("%s: uptime error %lld ms", what, (long long)error);
	}

	/* Exercises the cycle counter, which k_busy_wait() spins on. */
	k_busy_wait(100);
}

int test_pwr_mgmt_check_uptime(void)
{
	LOG_INF("Worst uptime error %lld ms (tolerance %d ms)", (long long)worst_uptime_error_ms,
		MAX_UPTIME_ERROR_MS);

	if (worst_uptime_error_ms > MAX_UPTIME_ERROR_MS) {
		LOG_ERR("Uptime did not track wall time across sleep");
		return -EIO;
	}

	return 0;
}

static void task_thread(uint32_t period_ms, char marker)
{
	while (true) {
		if (!run_threads) {
			/* Park holding no timeout: K_FOREVER adds none, so
			 * nothing of this thread's can wake the system while
			 * the sleep under test runs.
			 */
			k_sem_give(&parked_sem);
			(void)k_sem_take(&resume_sem, K_FOREVER);
			continue;
		}

		k_msleep(period_ms);

		if (run_threads) {
			printk("%c", marker);
		}
	}
}

static void task_a_thread(void *p1, void *p2, void *p3)
{
	ARG_UNUSED(p1);
	ARG_UNUSED(p2);
	ARG_UNUSED(p3);

	task_thread(THREAD_A_SLEEP_TIME, 'A');
}

static void task_b_thread(void *p1, void *p2, void *p3)
{
	ARG_UNUSED(p1);
	ARG_UNUSED(p2);
	ARG_UNUSED(p3);

	task_thread(THREAD_B_SLEEP_TIME, 'B');
}

static void create_tasks(void)
{
	k_sem_init(&parked_sem, 0, 2);
	k_sem_init(&resume_sem, 0, 2);
	run_threads = true;

	k_thread_create(&thread_a_id, stack_a, TASK_STACK_SIZE, task_a_thread, NULL, NULL, NULL,
			PRIORITY, K_INHERIT_PERMS, K_FOREVER);
	k_thread_create(&thread_b_id, stack_b, TASK_STACK_SIZE, task_b_thread, NULL, NULL, NULL,
			PRIORITY, K_INHERIT_PERMS, K_FOREVER);

	k_thread_start(&thread_a_id);
	k_thread_start(&thread_b_id);
}

static void destroy_tasks(void)
{
	run_threads = false;

	/* Release anything parked so the aborts below are not racing a pend. */
	k_sem_give(&resume_sem);
	k_sem_give(&resume_sem);

	k_thread_abort(&thread_a_id);
	k_thread_abort(&thread_b_id);

	k_thread_join(&thread_a_id, K_FOREVER);
	k_thread_join(&thread_b_id, K_FOREVER);
}

static void park_all_tasks(void)
{
	run_threads = false;

	k_wakeup(&thread_a_id);
	k_wakeup(&thread_b_id);

	/* Both threads park themselves; wait for them so no timeout outlives
	 * this call.
	 */
	k_sem_take(&parked_sem, K_FOREVER);
	k_sem_take(&parked_sem, K_FOREVER);
}

static void unpark_all_tasks(void)
{
	run_threads = true;

	k_sem_give(&resume_sem);
	k_sem_give(&resume_sem);
}

static struct pm_notifier notifier = {
	.state_entry = notify_pm_state_entry,
	.state_exit = notify_pm_state_exit,
};

static uint32_t light_sleep_ms(void)
{
	return (residency_info[0].min_residency_us / 1000U) + LT_EXTRA_SLP_TIME;
}

static uint32_t deep_sleep_ms(void)
{
	return (residency_info[residency_info_len - 1].min_residency_us / 1000U) +
	       DP_EXTRA_SLP_TIME;
}

static void report_wake(bool use_logging, const char *msg)
{
	if (use_logging) {
		LOG_INF("%s", msg);
	} else {
		printk("%s\n", msg);
	}
}

int test_pwr_mgmt_multithread(bool use_logging, uint8_t cycles)
{
	uint8_t iterations = cycles;

	/* Deep sleep is only reachable with the threads suspended: a running
	 * thread wakes the system before the deep residency is met. Covers
	 * zephyrproject-rtos/zephyr#20033.
	 */
	pm_notifier_register(&notifier);
	create_tasks();

	LOG_WRN("PM multi-thread test started for cycles: %d, logging: %d", cycles, use_logging);

	checks_enabled = true;
	while (iterations-- > 0) {
		LOG_INF("Park threads...");
		park_all_tasks();
		LOG_INF("About to enter light sleep");
		pm_sleep_and_measure(light_sleep_ms(), "light sleep");
		report_wake(use_logging, "Wake from Light Sleep");

		LOG_INF("Resume");
		unpark_all_tasks();

		LOG_INF("Park threads...");
		park_all_tasks();
		LOG_INF("About to enter deep sleep");

		pm_trigger_marker();
		pm_sleep_and_measure(deep_sleep_ms(), "deep sleep");
		report_wake(use_logging, "Wake from Deep Sleep");

		pm_exit_marker();
		LOG_INF("Resume");
		unpark_all_tasks();
	}

	destroy_tasks();

	LOG_INF("PM multi-thread completed");

	int ret = pm_check_counters(cycles);

	pm_reset_counters();
	pm_notifier_unregister(&notifier);

	return ret;
}

int test_pwr_mgmt_singlethread(bool use_logging, uint8_t cycles)
{
	uint8_t iterations = cycles;

	LOG_WRN("PM single-thread test started for cycles: %d, logging: %d", cycles, use_logging);

	pm_marker_init();
	pm_notifier_register(&notifier);
	checks_enabled = true;
	while (iterations-- > 0) {
		/* Light sleep: the 48 MHz PLL stays on. */
		LOG_INF("About to enter light sleep");
		pm_sleep_and_measure(light_sleep_ms(), "light sleep");
		report_wake(use_logging, "Wake from Light Sleep");

		/* Deep sleep: the 48 MHz PLL is gated. */
		LOG_INF("About to enter deep sleep");

		pm_trigger_marker();
		pm_sleep_and_measure(deep_sleep_ms(), "deep sleep");
		report_wake(use_logging, "Wake from Deep Sleep");

		pm_exit_marker();
	}

	LOG_INF("PM single-thread completed");

	int ret = pm_check_counters(cycles);

	pm_reset_counters();
	pm_notifier_unregister(&notifier);

	return ret;
}
```

## src/power_mgmt.h
```c
/*
 * SPDX-FileCopyrightText: Copyright The Zephyr Project Contributors
 * SPDX-License-Identifier: Apache-2.0
 */

#ifndef __TEST_PWRMGMT_H__
#define __TEST_PWRMGMT_H__

#include <stdbool.h>
#include <stdint.h>

/** @brief Alternates between light and deep sleep cycles.
 *
 * Sleeps in the main thread for longer than each state's minimum residency so
 * the PM policy selects that state.
 *
 * @param use_logging report progress with logging rather than printk.
 * @param cycles number of light/deep sleep pairs to run.
 * @retval 0 on success.
 * @retval -EIO if a PM state was entered a different number of times than
 *         requested, or entry and exit counts disagree.
 */
int test_pwr_mgmt_singlethread(bool use_logging, uint8_t cycles);

/** @brief Alternates between light and deep sleep cycles with threads running.
 *
 * As test_pwr_mgmt_singlethread(), with two periodic threads created and
 * suspended around each sleep. Deep sleep is only reachable while they are
 * suspended, which is what makes this distinct: a running thread keeps the
 * system out of the deeper state.
 *
 * @param use_logging report progress with logging rather than printk.
 * @param cycles number of light/deep sleep pairs to run.
 * @retval 0 on success.
 * @retval -EIO if a PM state was entered a different number of times than
 *         requested, or entry and exit counts disagree.
 */
int test_pwr_mgmt_multithread(bool use_logging, uint8_t cycles);

/** @brief Reports whether uptime tracked wall time across the sleep cycles.
 *
 * The kernel timer hands timekeeping to an always-on companion across a
 * low-power state, so a sleep the companion mismeasures shows up as uptime
 * that advanced by the wrong amount. Each sleep records the error between the
 * requested sleep and the uptime delta; this prints the worst case.
 *
 * @retval 0 if the largest error is within tolerance.
 * @retval -EIO otherwise.
 */
int test_pwr_mgmt_check_uptime(void);

/** @brief Enters deep sleep with a counter alarm armed.
 *
 * The XEC counter driver's pm_action leaves a counter running when an alarm
 * or periodic top callback is armed, because stopping it would drop the event
 * the application asked for. A running Basic Timer holds its CLK_REQ, so the
 * PCR keeps the PLL on for the sleep: the cost of an armed alarm is power, not
 * a missed event. This exercises that branch, which no other phase reaches.
 *
 * Does nothing unless a counter device is named by
 * chosen { zephyr,counter }; see counter_alarm.overlay.
 *
 * @retval 0 if the alarm fired across the sleep, or no counter is configured.
 * @retval -ENODEV if the chosen counter is not ready.
 * @retval -EIO if the alarm did not fire.
 * @retval other errno from the counter API.
 */
int test_pwr_mgmt_counter_alarm(void);

#endif /* __TEST_PWRMGMT_H__ */
```
